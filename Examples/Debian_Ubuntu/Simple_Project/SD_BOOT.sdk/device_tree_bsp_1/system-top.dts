/*
 * CAUTION: This file is automatically generated by Xilinx.
 * Version:  
 * Today is: Mon Sep 18 00:52:09 2023
 */


/dts-v1/;
/include/ "zynq-7000.dtsi"
/include/ "pcw.dtsi"
/ {
	chosen {
		bootargs = "mem=496M console=ttyPS0,115200 ramdisk_size=409600 root=/dev/mmcblk0p2 rootfstype=ext4 rw elevator=deadline rootwait earlycon";
		stdout-path = "serial0:115200n8";
	};
	aliases {
		ethernet0 = &gem0;
		serial0 = &uart1;
	};
	memory {
		device_type = "memory";
		reg = <0x0 0x10000000>;
	};
};
