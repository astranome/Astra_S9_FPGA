/*
 * CAUTION: This file is automatically generated by Xilinx.
 * Version:  
 * Today is: Sat Mar 30 14:48:04 2024
 */


/dts-v1/;
/include/ "zynq-7000.dtsi"
/include/ "pl.dtsi"
/include/ "pcw.dtsi"
/ {
	chosen {
		bootargs = "earlycon";
		stdout-path = "serial0:115200n8";
	};
	aliases {
		ethernet0 = &gem0;
		i2c0 = &i2c0;
		i2c1 = &i2c1;
		serial0 = &uart1;
		serial1 = &uart0;
		serial2 = &axi_uartlite_0;
		spi0 = &spi0;
	};
	memory {
		device_type = "memory";
		reg = <0x0 0x20000000>;
	};
};
